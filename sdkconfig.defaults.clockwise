## sdkconfig.defaults.clockwise
```kconfig
CONFIG_BOARD_CLOCKWISE=y
CONFIG_NO_INVERT_CLOCK_PHASE=y
CONFIG_HTTP_BUFFER_SIZE_MAX=80000
CONFIG_HTTP_BUFFER_SIZE_DEFAULT=20000
CONFIG_BOOT_WEBP_PARROT=y
CONFIG_ESPTOOLPY_FLASHSIZE_4MB=y
CONFIG_SPIRAM=n
CONFIG_MBEDTLS_EXTERNAL_MEM_ALLOC=n
CONFIG_PARTITION_TABLE_CUSTOM_FILENAME="boards/max_app_4mb.csv"
```
